#include <Adafruit_ILI9341.h>
#include <SPI.h>
#include <Keypad.h>
#include <Adafruit_GFX.h>
#include <EEPROM.h>

//-------------------- VARIABLES --------------------//

//Valores de los pines de la placa que se conectan a los de la pantalla TFT
const int CSv = 45;
const int RSTv = 47;
const int DCv = 49;
const int MOSIv = 51;
const int SCKv = 52;
const int MISOv = 50;

int addr = 0; //esta variable permite evitar errores al agregar valores a la memoria EEPROM

#define TFT_CS CSv
#define TFT_DC DCv
#define TFT_RST RSTv

//Configura la libreroa con la pantalla tft
Adafruit_ILI9341 tft = Adafruit_ILI9341(TFT_CS, TFT_DC, TFT_RST);

//Bitmaps - Organizados en Spritesheets para animaciones

const uint16_t roblox[] PROGMEM = { 0x0000, 0x0000, 0x0000, 0x0000, 0x0000, 0x0000, 0x0000, 0x0000, 0x0000, 0x0000, 0x0000, 0x0000, 0x0000,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 0xE686, 0xFE00 };

const uint16_t caminar1[32 * 32] PROGMEM = { 0x0000, 0x0000, 0x0000, 0x0000, 0x0000, 0x0000, 0x0000, 0x0000, 0x0000, 0x0000, 0x0000, 0x0000, 0x0000,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 0x0000, 0x0000 };

const uint16_t logoSimonDice[] PROGMEM = { 0xffff, 0xffff, 0xffff, 0xffff, 0xffff, 0xffff, 0xffff, 0xffff, 0xffff, 0xffff, 0xffff, 0xffff, 0xffff,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 0xffff, 0xffff};

const uint16_t logoSimonDice_select[] PROGMEM = { 0xffff, 0xffff, 0xffff, 0xffff, 0xffff, 0xffff, 0xffff, 0xffff, 0xffff, 0xffff, 0xffff, 0xffff, 0xffff,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 0xffff, 0xffff};

//Fuente leaderboard
const uint16_t A[11 * 11] PROGMEM = { 0x0000, 0x0000, 0x0000, 0x0000, 0x0000, 0x0000, 0x0000, 0x0000, 0x0000, 0x0000, 0x0000, 0x0000, 0x8430,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 0x0000, 0x0000};
const uint16_t B[11 * 11] PROGMEM = { 0x0000, 0x0000, 0x0000, 0x0000, 0x0000, 0x0000, 0x0000, 0x0000, 0x0000, 0x0000, 0x0000, 0x0000, 0x8430,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 0x0000, 0x0000};
const uint16_t C[11 * 11] PROGMEM = { 0x0000, 0x0000, 0x0000, 0x0000, 0x0000, 0x0000, 0x0000, 0x0000, 0x0000, 0x0000, 0x0000, 0x0000, 0x8430,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 0x0000, 0x0000};
const uint16_t D[11 * 11] PROGMEM = { 0x0000, 0x0000, 0x0000, 0x0000, 0x0000, 0x0000, 0x0000, 0x0000, 0x0000, 0x0000, 0x0000, 0x0000, 0x8430,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 0x0000, 0x0000};
const uint16_t E[11 * 11] PROGMEM = { 0x0000, 0x0000, 0x0000, 0x0000, 0x0000, 0x0000, 0x0000, 0x0000, 0x0000, 0x0000, 0x0000, 0x0000, 0x8430,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 0x0000, 0x0000};
const uint16_t F[11 * 11] PROGMEM = { 0x0000, 0x0000, 0x0000, 0x0000, 0x0000, 0x0000, 0x0000, 0x0000, 0x0000, 0x0000, 0x0000, 0x0000, 0x8430,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 0x0000, 0x0000};
const uint16_t G[11 * 11] PROGMEM = { 0x0000, 0x0000, 0x0000, 0x0000, 0x0000, 0x0000, 0x0000, 0x0000, 0x0000, 0x0000, 0x0000, 0x0000, 0x8430,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 0x0000, 0x0000};
const uint16_t H[11 * 11] PROGMEM = { 0x0000, 0x0000, 0x0000, 0x0000, 0x0000, 0x0000, 0x0000, 0x0000, 0x0000, 0x0000, 0x0000, 0x0000, 0x8430,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 0x0000, 0x0000};
const uint16_t I[11 * 11] PROGMEM = { 0x0000, 0x0000, 0x0000, 0x0000, 0x0000, 0x0000, 0x0000, 0x0000, 0x0000, 0x0000, 0x0000, 0x0000, 0x0000,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 0x0000, 0x0000};
const uint16_t J[11 * 11] PROGMEM = { 0x0000, 0x0000, 0x0000, 0x0000, 0x0000, 0x0000, 0x0000, 0x0000, 0x0000, 0x0000, 0x0000, 0x0000, 0x0000,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 0x0000, 0x0000};
const uint16_t K[11 * 11] PROGMEM = { 0x0000, 0x0000, 0x0000, 0x0000, 0x0000, 0x0000, 0x0000, 0x0000, 0x0000, 0x0000, 0x0000, 0x0000, 0xffff,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 0x0000, 0x0000};
const uint16_t L[11 * 11] PROGMEM = { 0x0000, 0x0000, 0x0000, 0x0000, 0x0000, 0x0000, 0x0000, 0x0000, 0x0000, 0x0000, 0x0000, 0x0000, 0x8430,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 0x0000, 0x0000};
const uint16_t M[13 * 11] PROGMEM = { 0x0000, 0x0000, 0x0000, 0x0000, 0x0000, 0x0000, 0x0000, 0x0000, 0x0000, 0x0000, 0x0000, 0x0000, 0x0000,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 0x0000, 0x0000};
const uint16_t N[12 * 11] PROGMEM = { 0x0000, 0x0000, 0x0000, 0x0000, 0x0000, 0x0000, 0x0000, 0x0000, 0x0000, 0x0000, 0x0000, 0x0000, 0x0000,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 0x0000, 0x0000};
const uint16_t O[11 * 11] PROGMEM = { 0x0000, 0x0000, 0x0000, 0x0000, 0x0000, 0x0000, 0x0000, 0x0000, 0x0000, 0x0000, 0x0000, 0x0000, 0x8430,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 0x0000, 0x0000};
const uint16_t P[12 * 11] PROGMEM = { 0x0000, 0x0000, 0x0000, 0x0000, 0x0000, 0x0000, 0x0000, 0x0000, 0x0000, 0x0000, 0x0000, 0x0000, 0x0000,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 0x0000, 0x0000};
const uint16_t Q[11 * 11] PROGMEM = { 0x0000, 0x0000, 0x0000, 0x0000, 0x0000, 0x0000, 0x0000, 0x0000, 0x0000, 0x0000, 0x0000, 0x0000, 0x8430,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 0x0000, 0x0000};
const uint16_t R[12 * 11] PROGMEM = { 0x0000, 0x0000, 0x0000, 0x0000, 0x0000, 0x0000, 0x0000, 0x0000, 0x0000, 0x0000, 0x0000, 0x0000, 0x0000,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 0x0000, 0x0000};
const uint16_t S[11 * 11] PROGMEM = { 0x0000, 0x0000, 0x0000, 0x0000, 0x0000, 0x0000, 0x0000, 0x0000, 0x0000, 0x0000, 0x0000, 0x0000, 0x8430,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 0x0000, 0x0000};
const uint16_t T[12 * 11] PROGMEM = { 0x0000, 0x0000, 0x0000, 0x0000, 0x0000, 0x0000, 0x0000, 0x0000, 0x0000, 0x0000, 0x0000, 0x0000, 0x0000,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 0x0000, 0x0000};
const uint16_t U[12 * 11] PROGMEM = { 0x0000, 0x0000, 0x0000, 0x0000, 0x0000, 0x0000, 0x0000, 0x0000, 0x0000, 0x0000, 0x0000, 0x0000, 0x0000,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 0x0000, 0x0000};
const uint16_t V[12 * 11] PROGMEM = { 0x0000, 0x0000, 0x0000, 0x0000, 0x0000, 0x0000, 0x0000, 0x0000, 0x0000, 0x0000, 0x0000, 0x0000, 0x0000,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 0x0000, 0x0000};
const uint16_t W[13 * 11] PROGMEM = { 0x0000, 0x0000, 0x0000, 0x0000, 0x0000, 0x0000, 0x0000, 0x0000, 0x0000, 0x0000, 0x0000, 0x0000, 0x0000,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 0x0000, 0x0000};
const uint16_t X[12 * 11] PROGMEM = { 0x0000, 0x0000, 0x0000, 0x0000, 0x0000, 0x0000, 0x0000, 0x0000, 0x0000, 0x0000, 0x0000, 0x0000, 0x0000,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 0x0000, 0x0000};
const uint16_t Y[12 * 11] PROGMEM = { 0x0000, 0x0000, 0x0000, 0x0000, 0x0000, 0x0000, 0x0000, 0x0000, 0x0000, 0x0000, 0x0000, 0x0000, 0x0000,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 0x0000, 0x0000};
const uint16_t Z[11 * 11] PROGMEM = { 0x0000, 0x0000, 0x0000, 0x0000, 0x0000, 0x0000, 0x0000, 0x0000, 0x0000, 0x0000, 0x0000, 0x0000, 0x8430,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 0x0000, 0x0000};

//Número de filas y columnas del keypad
const byte ROWS = 4;
const byte COLS = 4;
//Teclas del keypad en una matriz
char keys[ROWS][COLS] = {
  {'1','2','3','A'},
  {'4','5','6','B'},
  {'7','8','9','C'},
  {'*','0','#','D'}
};

int matrizSimon[3][3] = { // Esto es para obtener la fila y col del número para editar, creo que es lo más eficiente que podemos hacer
  {1, 2, 3},
  {4, 5, 6},
  {7, 8, 9}
};

int colorRGB;
int filaNumero = -1;
int colNumero = -1;

const int RondasMaximas = 64;

// Pines del Arduino conectados al teclado
byte rowPins[ROWS] = {2, 3, 4, 5};  
byte colPins[COLS] = {6, 7, 8 ,9};  

// Configura la libreria con el Keypad
Keypad keypad = Keypad(makeKeymap(keys), rowPins, colPins, ROWS, COLS);

// Esta variable define la instancia en la que se encuentra, su valor indica si se encuentra en el menu, en el Simon dice, etc
int gameState = 0;

//Ordena los valores de letra posibles en la seleccion de nombre (Leaderboard)
char letras[26] = {
  'A','B','C','D','E','F','G','H','I','J','K','L','M','N','O','P','Q','R','S','T','U','V','W','X','Y','Z'
};

//Contiene los nombres de los bitmaps de cada letra del array arriba ^, tienen que estar en el mismo orden para que el programa pueda saber que letra mostrar
const uint16_t *letrasBitmap[26] = {
  A, B, C, D, E, F, G, H, I, J, K, L, M,
  N, O, P, Q, R, S, T, U, V, W, X, Y, Z
};

//Estructura donde se guardan los datos del leaderboard
struct user{
  char nombre[4];
  int puntaje;
};

int flagDir = 0; const byte flag = 0xAB;
String Anombre1 = "XXX"; int Apuntaje1 = 0; user Auser1; const int Auser1dir = 1;
String Anombre2 = "XXX"; int Apuntaje2 = 0; user Auser2; const int Auser2dir = 7;
String Anombre3 = "XXX"; int Apuntaje3 = 0; user Auser3; const int Auser3dir = 13;
String Anombre4 = "XXX"; int Apuntaje4 = 0; user Auser4; const int Auser4dir = 19;
String Anombre5 = "XXX"; int Apuntaje5 = 0; user Auser5; const int Auser5dir = 25;

String Bnombre1 = "XXX"; int Bpuntaje1 = 0; user Buser1; const int Buser1dir = 31;
String Bnombre2 = "XXX"; int Bpuntaje2 = 0; user Buser2; const int Buser2dir = 37;
String Bnombre3 = "XXX"; int Bpuntaje3 = 0; user Buser3; const int Buser3dir = 43;
String Bnombre4 = "XXX"; int Bpuntaje4 = 0; user Buser4; const int Buser4dir = 49;
String Bnombre5 = "XXX"; int Bpuntaje5 = 0; user Buser5; const int Buser5dir = 55;

byte passwordGame[RondasMaximas];
byte passwordPlayer[RondasMaximas];
bool rondaPasada;
int puntajeSimon;
int indexGame;
int indexPlayer;

//-----JUEGO CARRERA DE CABALLOS-----//
int xPos;
bool barAttack = true;

byte numPlayers = 4;
char horseGamePlayerState[2][4] = {
  {'A', '3', '2', '1'},
  {0, 0, 0, 0}
};

int horsesPoints[2][4] = {
  {0, 0, 0, 0},
  {0, 0, 0, 0}
};
//-------------------- FUNCIONES --------------------//

void guardarDatoLB(int dir, String nombre, int puntaje, user userv){
  nombre.toCharArray(userv.nombre, sizeof(userv.nombre));
  userv.puntaje = puntaje;
  EEPROM.put(dir, userv);
}

user loadLB(user user1, user user2, user user3, user user4, user user5, int user1dir, int user2dir, int user3dir, int user4dir, int user5dir){
  EEPROM.get(user1dir, user1); 
  EEPROM.get(user2dir, user2);
  EEPROM.get(user3dir, user3);
  EEPROM.get(user4dir, user4);
  EEPROM.get(user5dir, user5);
  String nombre1 = user1.nombre; String nombre2 = user2.nombre; String nombre3 = user3.nombre; String nombre4 = user4.nombre; String nombre5 = user5.nombre;
  return(user1, user2, user3, user4, user5);
}

int loadP(user user1, user user2, user user3, user user4, user user5){
  int puntaje1 = user1.puntaje; int puntaje2 = user2.puntaje; int puntaje3 = user3.puntaje; int puntaje4 = user4.puntaje; int puntaje5 = user5.puntaje;
  return(puntaje1, puntaje2, puntaje3, puntaje4, puntaje5);
}

String loadN(user user1, user user2, user user3, user user4, user user5){
  String nombre1 = user1.nombre; String nombre2 = user2.nombre; String nombre3 = user3.nombre; String nombre4 = user4.nombre; String nombre5 = user5.nombre;
  return(nombre1, nombre2, nombre3, nombre4, nombre5);
}

// FUNCION para escalar bitmaps, lo dejamos acá por comodidad
void drawScaledRGBBitmapFloat(Adafruit_ILI9341 &tft, int16_t x, int16_t y, const uint16_t *bitmap, int16_t w, int16_t h, float scale) {
  for (int16_t j = 0; j < int(h * scale); j++) {
    for (int16_t i = 0; i < int(w * scale); i++) {
      int srcX = int(i / scale);
      int srcY = int(j / scale);
      uint16_t color = pgm_read_word(&bitmap[srcY * w + srcX]);
      tft.drawPixel(x + i, y + j, color);
    }
  }
}

void drawColorBox(int x, int y, int width , int height, uint16_t color) {
  tft.fillRect(x, y, width, height, color);
}

void drawMarkerBar(int x, int y, int width, int height) {
  int blockHeight = 10;
  bool white = true;
  for (int i = 0; i < height; i += blockHeight) {
    if (white) {
      tft.fillRect(x, y + i, width, blockHeight, ILI9341_WHITE);
    } else {
      tft.fillRect(x, y + i, width, blockHeight, ILI9341_BLACK);
    }
    white = !white;
  }
}

void mostrarLetra(int pos, int letraN){
  const uint16_t *letra = letrasBitmap[letraN];
  drawScaledRGBBitmapFloat(tft, pos, 110, letra, 11, 11, 6);
}

String selectName(){
  String name = "";
  Serial.print("Pon tus iniciales");
  tft.setCursor(40, 50);
  tft.setTextSize(2);
  tft.println("Nuevo puntaje mas alto, ingrese su nombre");
  for (int i = 0; i < 3; i++){
    bool selec = false;
    int letraN = 0;
    int posicion[] = {37, 127, 217};
    bool letraM = false; // Indica si la letra ya se printeo en la TFT
    while (selec == false){
      if (letraM == false) mostrarLetra(posicion[i], letraN);
      letraM = true;
      char key = keypad.getKey();
      //Se presiona la flecha ->
      if (key){
        if (key == '4'){
          if (letraN == 25){
            letraN = 0;
          }
          else{
            letraN++;
          }
          Serial.print(letraN);
          letraM = false;
        }
        //Se presiona la flecha <-
        else if (key == '*'){
          if (letraN == 0){
            letraN = 25;
          }
          else{
            letraN--;
          }
          Serial.print(letraN);
          letraM = false;
        }
        //Se presiona Enter
        else if (key == '7'){
          name += letras[letraN];
          Serial.print(name);
          selec = true;
        }
      }
    }
  }
  return name;
}

void showLeaderboard(int p1, int p2, int p3, int p4, int p5, String n1, String n2, String n3, String n4, String n5){
  tft.setTextSize(4);
  tft.setCursor(40, 10);
    tft.println("LEADERBOARD");
  tft.setTextSize(4);
  for (int i = 0; i < 10; i++){ 
    int p = 0;
    if (i % 2 != 0){
      p = 40; //Columna puntajes
    }
    else{
      p = 200; //Columna Nombres
    }
    
    int h = 0;
    if(i <= 2){h = 50;}
    if(i <= 4 && i > 2){h = 90;};
    if(i <= 6 && i > 4){h = 130;};
    if(i <= 8 && i > 6){h = 170;};
    if(i <= 10 && i > 8){h = 210;};

    tft.setCursor(p, h);

    if(i == 1){tft.println(n1);}
    else if(i == 2){tft.println(p1);}
    else if(i == 3){tft.println(n2);}
    else if(i == 4){tft.println(p2);}
    else if(i == 5){tft.println(n3);}
    else if(i == 6){tft.println(p3);}
    else if(i == 7){tft.println(n4);}
    else if(i == 8){tft.println(p4);}
    else if(i == 9){tft.println(n5);}
    else if(i == 10){tft.println(p5);}
  }
}

int checkLeaderboard(int puntaje, int p1, int p2, int p3, int p4, int p5, String n1, String n2, String n3, String n4, String n5) {
  if (puntaje > p1){
    p5 = p4;
    p4 = p3;
    p3 = p2;
    p2 = p1;
    p1 = puntaje;
    String nombre = selectName();
    n5 = n4;
    n4 = n3;
    n3 = n2;
    n2 = n1;
    n1 = nombre;
  }
  else if (puntaje > p2){
    p5 = p4;
    p4 = p3;
    p3 = p2;
    p2 = puntaje;
    String nombre = selectName();
    n5 = n4;
    n4 = n3;
    n3 = n2;
    n2 = nombre;
  }
  else if (puntaje > p3){
    p5 = p4;
    p4 = p3;
    p3 = puntaje;
    String nombre = selectName();
    n5 = n4;
    n4 = n3;
    n3 = nombre;
  }
  else if (puntaje > p4){
    p5 = p4;
    p4 = puntaje;
    String nombre = selectName();
    n5 = n4;
    n4 = nombre;
  }
  else if (puntaje > p5){
    p5 = puntaje;
    String nombre = selectName();
    n5 = nombre;
  }

  tft.fillScreen(ILI9341_BLACK);
  showLeaderboard(p1, p2, p3, p4, p5, n1, n2, n3, n4, n5);
  
}

void gameOverScreen(){
  int opcSelec = 1;
  int opcShowing = 2;
  tft.fillScreen(ILI9341_RED);

  tft.setCursor((tft.width()-216)/2, 60);
  tft.setTextSize(4);
  tft.setTextColor(tft.color565(255, 255, 255));
  tft.println("GAME OVER");
 
  
  tft.setCursor((tft.width()- 120)/2, 120);
  tft.setTextSize(2);
  tft.println("Ir al menu");

  tft.setCursor((tft.width()- 168)/2, 150);
  tft.println("Volver a jugar");



  while (gameState == -1) {

    char key = keypad.getKey();
   
    if (key) {
      if (key == '4' && opcSelec > 1){
        opcSelec -= 1;
      }
      else if (key == '*' && opcSelec < 2){
        opcSelec += 1;
      }
      else if (key == '7'){
        if (opcSelec == 1){
          gameState = 10;
        }
        else{
          gameState = 0;
        }
      }
    }

    if (opcSelec == 1 && opcShowing == 2){
      opcShowing = 1;
      tft.fillRect((tft.width()- 168)/2 - 20, 150, 10, 10, ILI9341_WHITE);
      tft.fillRect((tft.width()- 120)/2 - 20, 120, 10 , 10, ILI9341_RED);
    }
    else if (opcSelec == 2 && opcShowing == 1){
      opcShowing = 2;
      tft.fillRect((tft.width()- 120)/2 - 20, 120, 10 , 10, ILI9341_WHITE);
      tft.fillRect((tft.width()- 168)/2 - 20, 150, 10, 10, ILI9341_RED);
    }
  }
}

void showPointsSimon(int points){
  tft.fillRect(255, 20, 35, 35, tft.color565(191, 191, 191));
  tft.setCursor(265, 30);
  tft.setTextSize(3);
  tft.setTextColor(tft.color565(255, 255, 255));
  tft.println(points);
}

int menu(int cantJuegos) {
  
  int end = 0;
  int juegoSelec = 1;
  int showGame = 2;
  tft.fillScreen(ILI9341_BLACK);
  while (end == 0) {

    char key = keypad.getKey();
   
    if (key) {
      if (key == '4' && juegoSelec < cantJuegos){
        juegoSelec += 1;
      }
      else if (key == '*' && juegoSelec > 1){
        juegoSelec -= 1;
      }
      else if (key == '7'){
        end = 1;
        juegoSelec *= 10;
      }
    }

    if (juegoSelec == 1 && (showGame == 2 || showGame == 3)) {
      showGame = 1;
      tft.fillRect(46, 16, 228, 24, 0x0000);
      tft.setTextSize(3);
      tft.setTextColor(ILI9341_WHITE);
      tft.setCursor((tft.width() - 180) / 2, 16);
      tft.println("Simon dice");
      tft.drawRGBBitmap(tft.width()/2 - 128, 128, logoSimonDice_select, 64, 64);
      tft.drawRGBBitmap(tft.width()/2 - 32, 128, logoSimonDice, 64, 64);
      tft.drawRGBBitmap(tft.width()/2 + 64, 128, logoSimonDice, 64, 64);
      Serial.print(key);
    }
   
    else if (juegoSelec == 2 && (showGame == 1 || showGame == 3)) {
      showGame = 2;
      tft.fillRect(46, 16, 228, 24, 0x0000);
      tft.setTextSize(2);
      tft.setTextColor(ILI9341_WHITE);
      tft.setCursor((tft.width() - 228) / 2, 16);
      tft.println("Carrera de caballos");
      tft.drawRGBBitmap(tft.width()/2 - 128, 128, logoSimonDice, 64, 64);
      tft.drawRGBBitmap(tft.width()/2 - 32, 128, logoSimonDice_select, 64, 64);
      tft.drawRGBBitmap(tft.width()/2 + 64, 128, logoSimonDice, 64, 64);
      Serial.print(key);
    }

    else if (juegoSelec == 3 && (showGame == 1 || showGame == 2)) {
      showGame = 3;
      tft.fillRect(46, 16, 228, 24, 0x0000);
      tft.setTextSize(3);
      tft.setTextColor(ILI9341_WHITE);
      tft.setCursor((tft.width() - 180) / 2, 16);
      tft.println("Leaderboard");
      tft.drawRGBBitmap(tft.width()/2 - 128, 128, logoSimonDice, 64, 64);
      tft.drawRGBBitmap(tft.width()/2 - 32, 128, logoSimonDice, 64, 64);
      tft.drawRGBBitmap(tft.width()/2 + 64, 128, logoSimonDice_select, 64, 64);
      Serial.print(key);
    }
  }

  return juegoSelec;
}


int drawSquareSimonGame(int num, int pressed){
  // Encontrar fila y columna del número
  for (int row = 0; row < 3; row++){
        for(int col = 0; col < 3; col++){
          if (matrizSimon[row][col] == num){
            filaNumero = row;
            colNumero = col;
            break; // Salimos del for de columnas
          }
        }
  }
  if (pressed == 0) colorRGB = tft.color565(40, 112, 181); else if (pressed == 1)  colorRGB = tft.color565(27, 77, 125); else if (pressed == 2) colorRGB = tft.color565(87, 153, 217);

  // Establecer posiciones de x e y
  int x = tft.width()/2 - 80 + colNumero * (50 + 5);  // posición x
  int y = 40 + filaNumero * (50 + 5);  // posición y
 
  // Cuadro
  tft.fillRect(x, y, 50, 50, colorRGB);  
 
  // Texto
  tft.setTextColor(tft.color565(191, 191, 191));
  tft.setTextSize(3);
  tft.setCursor(x + 18, y + 15);
  tft.print(num++); // Escribe el número de la posición, y luego le suma 1
 
  return num;
}

void drawHorsesRelativePos(int arr[2][4]){

  int multiplier = 5;
  // Borrado eficiente de caballos anteriores en posiciones anteriores
  for (int i = 0; i < 4; i++){ 
    if (arr[0][i] != arr[1][1]){  // Si la posicion actual es desigual a la posicion anterior (O sea que se movió)
      tft.fillRect(10 + arr[1][i] * multiplier, 20 + i * 40, 30, 20, ILI9341_DARKGREY); // Limpiar posición anterior
    }
  }


  tft.fillRect(10 + arr[0][0] * multiplier, 20, 30, 20, ILI9341_RED);
  tft.fillRect(10 + arr[0][1] * multiplier, 60, 30, 20, ILI9341_YELLOW);
  tft.fillRect(10 + arr[0][2] * multiplier, 100, 30, 20, ILI9341_GREEN);
  tft.fillRect(10 + arr[0][3] * multiplier, 140, 30, 20, ILI9341_BLUE);
}

void drawHorsesGameBase(){
  tft.fillScreen(ILI9341_DARKGREY);
  drawHorsesRelativePos(horsesPoints);
 
  // Dibujo de caballos
  
 
  // Dibujo de la meta
  drawMarkerBar(tft.width() - 30, 15, 20, 160);


}


uint16_t playersBarColors[4] ={ILI9341_RED, ILI9341_YELLOW, ILI9341_GREEN, ILI9341_BLUE};

void attackHorseSistem(){

  while (xPos < 400){
    tft.fillRect(10 + xPos, tft.height() - 5, 10, 3, ILI9341_WHITE);
    tft.fillRect(10 + xPos, tft.height() - 47.5, 10, 3, ILI9341_WHITE);
    delay(50);
    tft.fillRect(10 + xPos, tft.height() - 5, 10, 3, ILI9341_DARKGREY);
    tft.fillRect(10 + xPos, tft.height() - 47.5, 10, 3, ILI9341_DARKGREY);
    xPos += 12;
    if (keypad.getKeys()) {
      for (int i = 0; i < LIST_MAX; i++) {
        if (keypad.key[i].stateChanged) {
          char tecla = keypad.key[i].kchar;
          byte estado = keypad.key[i].kstate;

          // Buscar qué jugador corresponde
          for (int j = 0; j < numPlayers; j++) {
            if (tecla == horseGamePlayerState[0][j]) {
              if (estado == PRESSED) {
                horseGamePlayerState[1][j] = 1;
                tft.fillRect(10 + xPos, tft.height() - 47.5, 10, 45, playersBarColors[j]);
                
                horsesPoints[1][j] = horsesPoints[0][j];  // guardás puntaje anterior
                if (xPos >= 8 * 12 && xPos <= 16 * 12){
                    horsesPoints[0][j]++;               // sumás puntos
                    if (xPos >= 11 * 12 && xPos <= 13 * 12){
                        horsesPoints[0][j] += 2;
                    }
}

                /*
                Serial.print("Jugador ");
                Serial.print(j + 1);
                Serial.println(" PRESIONÓ");
                */
              } 
              else if (estado == RELEASED) {
                horseGamePlayerState[1][j] = 0;
              }
            }
          }
        }
      }
    }
  }

}

void drawSimonGameBase() {

  // Fondo del juego
  tft.fillScreen(tft.color565(0, 102, 204));
  tft.fillRect(20, 20, tft.width() - 40, tft.height() - 40, tft.color565(102, 178, 255));

  // Dibujar los 9 cuadros azul oscuro con números
  int num = 1;
  for (int row = 0; row < 3; row++) {
    for (int col = 0; col < 3; col++) {
      drawSquareSimonGame(num, false);
      num++;
    }
  }
  showPointsSimon(puntajeSimon);
}

int pointsCalculator(int basePoints, float multiplier){
  int realScore = basePoints * multiplier;
  return realScore;
}



//-------------------- PROGRAMA PRINCIPAL --------------------//



void setup() {

  // Setup del SerialMonitor y el LCD TFT
  Serial.begin(9600);
  tft.begin();
  tft.setRotation(3);

  randomSeed(analogRead(A0)); // Semilla aleatoria unica

  // drawScaledRGBBitmapFloat(tft, 0, 0, Z, 11, 11, 6);

  Serial.print(EEPROM.read(flagDir));

  if (EEPROM.read(flagDir) != flag){
    guardarDatoLB(Auser1dir, Anombre1, Apuntaje1, Auser1);
    guardarDatoLB(Auser2dir, Anombre2, Apuntaje2, Auser2);
    guardarDatoLB(Auser3dir, Anombre3, Apuntaje3, Auser3);
    guardarDatoLB(Auser4dir, Anombre4, Apuntaje4, Auser4);
    guardarDatoLB(Auser5dir, Anombre5, Apuntaje5, Auser5);

    guardarDatoLB(Buser1dir, Bnombre1, Bpuntaje1, Buser1);
    guardarDatoLB(Buser2dir, Bnombre2, Bpuntaje2, Buser2);
    guardarDatoLB(Buser3dir, Bnombre3, Bpuntaje3, Buser3);
    guardarDatoLB(Buser4dir, Bnombre4, Bpuntaje4, Buser4);
    guardarDatoLB(Buser5dir, Bnombre5, Bpuntaje5, Buser5);
    EEPROM.write(flagDir, flag);
  }
  else{
    (Auser1, Auser2, Auser3, Auser4, Auser5) = loadLB(Auser1, Auser2, Auser3, Auser4, Auser5, Auser1dir, Auser2dir, Auser3dir, Auser4dir, Auser5dir);
    (Buser1, Buser2, Buser3, Buser4, Buser5) = loadLB(Buser1, Buser2, Buser3, Buser4, Buser5, Buser1dir, Buser2dir, Buser3dir, Buser4dir, Buser5dir);
    
    (Apuntaje1, Apuntaje2, Apuntaje3, Apuntaje4, Apuntaje5) = loadP(Auser1, Auser2, Auser3, Auser4, Auser5);
    (Bpuntaje1, Bpuntaje2, Bpuntaje3, Bpuntaje4, Bpuntaje5) = loadP(Buser1, Buser2, Buser3, Buser4, Buser5);

    (Anombre1, Anombre2, Anombre3, Anombre4, Anombre5) = loadN(Auser1, Auser2, Auser3, Auser4, Auser5);
    (Bnombre1, Bnombre2, Bnombre3, Bnombre4, Bnombre5) = loadN(Buser1, Buser2, Buser3, Buser4, Buser5);
  }

  while (0 == 0){
  }  
}

void loop() {

  if (gameState == 0){
    gameState = menu(3);
  }
  else if (gameState == 10){ // que 10 sea el iniciador del juego, y 1 cuando se está jugando (para no hacer otra variable), aplicar lo mismo con juego 2
    memset(passwordGame, 0, sizeof(passwordGame));
    memset(passwordGame, 0, sizeof(passwordGame));
    rondaPasada = true;
    puntajeSimon = 0;
    indexGame = 0;
    indexPlayer = 0;
    drawSimonGameBase();
    gameState = 1;
  }
 
  else if (gameState == 1){ // Juego N1: Simon Dice
    for (int i = 0; i < indexGame; i++) {
      Serial.print("Tecla borrada: ");
      Serial.println(passwordGame[i]);
      drawSquareSimonGame(passwordGame[i], 0);
    }
   
    if (indexGame < RondasMaximas) {
      passwordGame[indexGame] = random(1, 10);
      Serial.print("Numero agregado: ");
      Serial.println(passwordGame[indexGame]);
      indexGame++;
    }

    //---MOSTRAR CLAVE GENERADA---//
      // Parte TERMINAL
    Serial.print("Clave: ");
    for (int i = 0; i < indexGame; i++) {
      Serial.print(passwordGame[i]);
      Serial.print(" ");
     
       // Reiniciar fila y columna antes de buscar
      filaNumero = -1;
      colNumero = -1;
      // Parte TFT
     
      drawSquareSimonGame(passwordGame[i], 1);
      delay(1000);
      drawSquareSimonGame(passwordGame[i], 0);
    }

    Serial.println("\n----------");

    // JUGADOR INTENTA REPLICAR CLAVE
    indexPlayer = 0;
    while (indexPlayer < indexGame) {
      char key = keypad.getKey();
      if (key) {
        if (key >= '0' && key <= '9') { // Si toca un numero

          passwordPlayer[indexPlayer] = key - '0'; // convierte char '3' → int 3
          Serial.print("Tecla elegida: ");
          Serial.println(passwordPlayer[indexPlayer]);
          drawSquareSimonGame(passwordPlayer[indexPlayer], 2);
          delay(1000);
          drawSquareSimonGame(passwordPlayer[indexPlayer], 0);
         
        }
        else { // Si no toca un numero
          Serial.println("Tecla no válida");
          rondaPasada = false;
          break;
        }
        if (rondaPasada == true){
          /* Serial.println(passwordPlayer[indexPlayer]);
          Serial.println(passwordGame[indexPlayer]); */
          if (passwordPlayer[indexPlayer] != passwordGame[indexPlayer]) { // Si tocó un número, pero la tecla no es correcta, así se detiene el programa sin esperar a que tenga la misma longitud de la clave a copiar
            Serial.println("TECLA INCORRECTA");
            rondaPasada = false;
            break;
          }
        }
        indexPlayer++;
      }
    }

    if (rondaPasada) {
      puntajeSimon++;
      Serial.println("GG, pasaste la ronda!");
      showPointsSimon(puntajeSimon);
    } else {
     
      Serial.println("Fallaste! Buena suerte la prox.");
      gameState = -1;
      gameOverScreen();

      }

    delay(1000);
  }
  else if (gameState == 20){
  drawHorsesGameBase();
  xPos = 0;

  // Hacer parte de ingresado de nombres @sapato
  // 3
  tft.fillRect(tft.width()/2 - 50, tft.height()/2 - 50, 100, 100, ILI9341_WHITE);
  tft.fillRect(tft.width()/2 - 40, tft.height()/2 - 40, 80, 80, ILI9341_BLACK);
  tft.setTextColor(ILI9341_RED);
  tft.setTextSize(6);
  tft.setCursor(tft.width()/2 - 18, tft.height()/2 - 20);
  tft.print("3");
  delay(1000);
  // 2
  tft.fillRect(tft.width()/2 - 40, tft.height()/2 - 40, 80, 80, ILI9341_BLACK);
  tft.setTextColor(ILI9341_ORANGE);
  tft.setCursor(tft.width()/2 - 18, tft.height()/2 - 20);
  tft.print("2");
  delay(1000);
  // 1
  tft.fillRect(tft.width()/2 - 40, tft.height()/2 - 40, 80, 80, ILI9341_BLACK);
  tft.setTextColor(ILI9341_YELLOW);
  tft.setCursor(tft.width()/2 - 18, tft.height()/2 - 20);
  tft.print("1");
  delay(1000);
  // GO
  tft.fillRect(tft.width()/2 - 40, tft.height()/2 - 40, 80, 80, ILI9341_BLACK);
  tft.setTextColor(ILI9341_GREEN);
  tft.setTextSize(4);
  tft.setCursor(tft.width()/2 - 25, tft.height()/2 - 15);
  tft.print("GO");
  delay(800);
  tft.fillRect(tft.width()/2 - 50, tft.height()/2 - 50, 100, 100, ILI9341_DARKGREY);
  barAttack = true;
  gameState = 2;
  
  }
  else if (gameState == 2){ // Juego N2: Carrera de caballos con 4 jugadores

    xPos = 0;
    if (barAttack == true){
      // Crear Barra de ataque
      tft.fillRect(10 , tft.height() - 47.5, tft.width() - 20, 45, ILI9341_DARKGREY);
      tft.fillRect(10 , tft.height() - 40, tft.width() - 20, 30, ILI9341_BLACK);
      tft.fillRect(tft.width()/3 , tft.height() - 40, tft.width()/3, 30, ILI9341_GREEN);
      tft.fillRect(tft.width()/2 -10 , tft.height() - 40, 20, 30, ILI9341_YELLOW);

      delay(500);
      attackHorseSistem();
      for (int i = 0; i < numPlayers; i++) {
        Serial.print("Puntaje Player ");
        Serial.print(i + 1);
        Serial.print(": ");
        Serial.print(horsesPoints[0][i]);
        Serial.print(", puntaje Anterior");
        Serial.print(": ");
        Serial.println(horsesPoints[1][i]);
      }
    }
    drawHorsesRelativePos(horsesPoints);
  }
 
}